/**
 * @file test_ble_dewhiten.cpp
 * @brief Host-side unit tests for nrf24::ble::swapbits() and dewhiten().
 *
 * Validates the BLE data dewhitening implementation against the following
 * acceptance criteria:
 *
 *   AC-1  swapbits() correctly reverses bit order within a byte
 *   AC-2  swapbits() is an involution: swapbits(swapbits(x)) == x
 *   AC-3  dewhiten() produces correct output for known whitened vectors
 *         (cross-verified against Dmitry Grinberg's Python reference)
 *   AC-4  dewhiten() round-trips: original → whiten → swapbits → dewhiten → original
 *   AC-5  dewhiten() is channel-dependent (different channels produce different output)
 *   AC-6  dewhiten() handles edge cases: zero-length, single-byte, all-zero,
 *         all-0xFF, maximum 32-byte payloads
 *   AC-7  dewhiten() on all-zero input yields the raw whitening sequence bytes
 *   AC-8  Full RX pipeline: bit-swap + dewhiten recovers original BLE PDU
 *   AC-9  After dewhitening, PDU header fields are valid
 *
 * Known vectors generated by docs/pipeline/scripts/ble_whiten_reference.py
 * which implements Dmitry Grinberg's btLeWhiten exactly.
 *
 * @see nrf24::ble::swapbits()  — bit reversal (ble.h)
 * @see nrf24::ble::dewhiten()  — Galois LFSR dewhitening (ble.cpp)
 * @see docs/pipeline/scripts/ble_whiten_reference.py
 */

#include <gtest/gtest.h>
#include <cstdint>
#include <cstring>
#include <array>

#include <nrf24l01plus/ble.h>

using namespace nrf24::ble;

/* ═══════════════════════════════════════════════════════════════════════════
 * swapbits() tests (AC-1, AC-2)
 * ═══════════════════════════════════════════════════════════════════════════ */

/** @brief Verify swapbits on identity values: all-zeros and all-ones stay unchanged. */
TEST(Swapbits, IdentityValues) {
    EXPECT_EQ(swapbits(0x00), 0x00);
    EXPECT_EQ(swapbits(0xFF), 0xFF);
}

/** @brief Verify swapbits on palindromic bytes (bit pattern reads the same forwards and backwards).
 *
 * A byte is bit-palindromic when swapbits(v) == v, i.e., bit[i] == bit[7-i]
 * for all i.  There are exactly 16 such values among all uint8_t.
 */
TEST(Swapbits, PalindromicBytes) {
    EXPECT_EQ(swapbits(0x00), 0x00);  /* 0b00000000 */
    EXPECT_EQ(swapbits(0x18), 0x18);  /* 0b00011000 */
    EXPECT_EQ(swapbits(0x24), 0x24);  /* 0b00100100 */
    EXPECT_EQ(swapbits(0x3C), 0x3C);  /* 0b00111100 */
    EXPECT_EQ(swapbits(0x42), 0x42);  /* 0b01000010 */
    EXPECT_EQ(swapbits(0x5A), 0x5A);  /* 0b01011010 */
    EXPECT_EQ(swapbits(0x66), 0x66);  /* 0b01100110 */
    EXPECT_EQ(swapbits(0x7E), 0x7E);  /* 0b01111110 */
    EXPECT_EQ(swapbits(0x81), 0x81);  /* 0b10000001 */
    EXPECT_EQ(swapbits(0x99), 0x99);  /* 0b10011001 */
    EXPECT_EQ(swapbits(0xA5), 0xA5);  /* 0b10100101 */
    EXPECT_EQ(swapbits(0xBD), 0xBD);  /* 0b10111101 */
    EXPECT_EQ(swapbits(0xC3), 0xC3);  /* 0b11000011 */
    EXPECT_EQ(swapbits(0xDB), 0xDB);  /* 0b11011011 */
    EXPECT_EQ(swapbits(0xE7), 0xE7);  /* 0b11100111 */
    EXPECT_EQ(swapbits(0xFF), 0xFF);  /* 0b11111111 */
}

/** @brief Verify swapbits on known non-palindromic byte reversals. */
TEST(Swapbits, KnownReversals) {
    EXPECT_EQ(swapbits(0x01), 0x80);  /* bit 0 → bit 7 */
    EXPECT_EQ(swapbits(0x80), 0x01);  /* bit 7 → bit 0 */
    EXPECT_EQ(swapbits(0x0F), 0xF0);  /* low nibble → high nibble */
    EXPECT_EQ(swapbits(0xF0), 0x0F);  /* high nibble → low nibble */
    EXPECT_EQ(swapbits(0x02), 0x40);  /* bit 1 → bit 6 */
    EXPECT_EQ(swapbits(0x04), 0x20);  /* bit 2 → bit 5 */
    EXPECT_EQ(swapbits(0x08), 0x10);  /* bit 3 → bit 4 */
    EXPECT_EQ(swapbits(0x10), 0x08);  /* bit 4 → bit 3 */
    EXPECT_EQ(swapbits(0x20), 0x04);  /* bit 5 → bit 2 */
    EXPECT_EQ(swapbits(0x40), 0x02);  /* bit 6 → bit 1 */
}

/** @brief Verify swapbits is an involution for selected edge-case values. */
TEST(Swapbits, Involution_EdgeCases) {
    /* swapbits(swapbits(x)) == x for edge cases */
    uint8_t const edges[] = {0x00, 0x01, 0x02, 0x04, 0x08, 0x10, 0x20, 0x40, 0x80,
                              0x0F, 0xF0, 0x55, 0xAA, 0x42, 0xFF, 0xDE, 0xAD, 0xBE, 0xEF};
    for (auto v : edges) {
        EXPECT_EQ(swapbits(swapbits(v)), v)
            << "swapbits(swapbits(0x" << std::hex << (int)v << ")) != 0x" << (int)v;
    }
}

/** @brief Verify swapbits is an involution for ALL 256 uint8_t values. */
TEST(Swapbits, Involution_All256) {
    for (int i = 0; i <= 0xFF; i++) {
        uint8_t v = static_cast<uint8_t>(i);
        EXPECT_EQ(swapbits(swapbits(v)), v)
            << "swapbits(swapbits(0x" << std::hex << i << ")) failed";
    }
}

/* ═══════════════════════════════════════════════════════════════════════════
 * dewhiten() tests (AC-3 through AC-9)
 * ═══════════════════════════════════════════════════════════════════════════ */

/**
 * @brief Helper: simulate nRF24 TX-side pipeline (whiten + swapbits).
 *
 * Takes BLE-format plaintext, applies Galois LFSR whitening (pure XOR,
 * no bit-swap), then bit-swaps each byte to produce nRF24-format output.
 * This is what the nRF24 would receive over-the-air and store in its FIFO.
 *
 * @param plaintext  BLE-format PDU bytes (LSbit-first on-air order).
 * @param len        Number of bytes.
 * @param ch         BLE channel index (0–39).
 * @param out        Output buffer (must be at least len bytes).
 */
static void simulate_nrf24_tx(const uint8_t *plaintext, uint8_t len,
                               uint8_t ch, uint8_t *out)
{
    /* Step 1: Galois LFSR whitening (same as dewhiten step 2 — XOR is symmetric) */
    uint8_t lfsr = swapbits(ch) | 0x02;
    for (uint8_t i = 0; i < len; i++) {
        uint8_t w = 0;
        for (uint8_t m = 1; m; m <<= 1) {
            if (lfsr & 0x80) {
                lfsr ^= 0x11;
                w ^= m;
            }
            lfsr <<= 1;
        }
        out[i] = plaintext[i] ^ w;
    }
    /* Step 2: bit-swap (BLE LSbit-first → nRF24 MSbit-first) */
    for (uint8_t i = 0; i < len; i++) {
        out[i] = swapbits(out[i]);
    }
}

/** @brief AC-4: Round-trip on BLE advertising channels 37, 38, 39. */
TEST(Dewhiten, RoundTrip_AdvChannels) {
    const uint8_t original[] = {0x40, 0x0B, 0xEF, 0xFF, 0xC0, 0xAA, 0x18, 0x00};
    uint8_t buf[8];
    uint8_t nrf24[8];

    for (uint8_t ch : {37, 38, 39}) {
        /* Simulate nRF24 TX: whiten then swapbits */
        simulate_nrf24_tx(original, 8, ch, nrf24);
        /* Copy into mutable buffer for dewhiten */
        std::memcpy(buf, nrf24, 8);
        /* dewhiten: swapbits then LFSR XOR → should recover original */
        dewhiten(buf, 8, ch);
        for (int i = 0; i < 8; i++) {
            EXPECT_EQ(buf[i], original[i])
                << "ch=" << (int)ch << " byte " << i
                << ": got 0x" << std::hex << (int)buf[i]
                << " expected 0x" << (int)original[i];
        }
    }
}

/** @brief AC-4: Round-trip on data channels 0, 10, 20. */
TEST(Dewhiten, RoundTrip_DataChannels) {
    const uint8_t original[] = {0xDE, 0xAD, 0xBE, 0xEF};
    uint8_t buf[4];
    uint8_t nrf24[4];

    for (uint8_t ch : {0, 10, 20}) {
        simulate_nrf24_tx(original, 4, ch, nrf24);
        std::memcpy(buf, nrf24, 4);
        dewhiten(buf, 4, ch);
        for (int i = 0; i < 4; i++) {
            EXPECT_EQ(buf[i], original[i])
                << "ch=" << (int)ch << " byte " << i;
        }
    }
}

/** @brief AC-3: Known whitened vectors for channel 37 (seed 0xA6).
 *
 * Vectors cross-verified against ble_whiten_reference.py:
 *   Original BLE: {0x40, 0x0B, 0xEF, 0xFF, 0xC0, 0xAA, 0x18, 0x00}
 *   After LFSR whitening on ch37: {0x8D, 0xD9, 0xB8, 0x5E, 0xFD, 0x0D, 0x7E, 0xB0}
 *   After swapbits to nRF24 format: {0xB1, 0x9B, 0x1D, 0x7A, 0xBF, 0xB0, 0x7E, 0x0D}
 *   dewhiten must recover the original BLE bytes.
 */
TEST(Dewhiten, KnownVector_Channel37) {
    /* nRF24-format input (whitened + bit-swapped) */
    const uint8_t nrf24_input[] = {0xB3, 0x9B, 0x1D, 0x7A, 0xBF, 0xB0, 0x7E, 0x0D};
    const uint8_t expected[]    = {0x40, 0x0B, 0xEF, 0xFF, 0xC0, 0xAA, 0x18, 0x00};
    uint8_t buf[8];
    std::memcpy(buf, nrf24_input, 8);

    dewhiten(buf, 8, 37);

    for (int i = 0; i < 8; i++) {
        EXPECT_EQ(buf[i], expected[i])
            << "byte " << i << ": got 0x" << std::hex << (int)buf[i]
            << " expected 0x" << (int)expected[i];
    }
}

/** @brief AC-3: Known whitened vectors for channel 38 (seed 0x66). */
TEST(Dewhiten, KnownVector_Channel38) {
    const uint8_t nrf24_input[] = {0x69, 0xC3, 0xFB, 0x5E, 0xCC, 0x78, 0xAC, 0x0B};
    const uint8_t expected[]    = {0x40, 0x06, 0x9B, 0x5A, 0x6A, 0xC0, 0xD4, 0x5F};
    uint8_t buf[8];
    std::memcpy(buf, nrf24_input, 8);

    dewhiten(buf, 8, 38);

    for (int i = 0; i < 8; i++) {
        EXPECT_EQ(buf[i], expected[i])
            << "byte " << i << ": got 0x" << std::hex << (int)buf[i]
            << " expected 0x" << (int)expected[i];
    }
}

/** @brief AC-3: Known whitened vectors for channel 39 (seed 0xE6), all-zero original. */
TEST(Dewhiten, KnownVector_Channel39_AllZero) {
    /* For ch39, all-zero BLE plaintext whitened then swapped: */
    const uint8_t nrf24_input[] = {0xF8, 0xEC, 0x52, 0xFA, 0xA1, 0x6F, 0x39, 0x59};
    const uint8_t expected[]    = {0x00, 0x00, 0x00, 0x00, 0x00, 0x00, 0x00, 0x00};
    uint8_t buf[8];
    std::memcpy(buf, nrf24_input, 8);

    dewhiten(buf, 8, 39);

    for (int i = 0; i < 8; i++) {
        EXPECT_EQ(buf[i], expected[i])
            << "byte " << i << ": got 0x" << std::hex << (int)buf[i]
            << " expected 0x" << (int)expected[i];
    }
}

/** @brief AC-6: Zero-length buffer must not crash or modify anything. */
TEST(Dewhiten, ZeroLength) {
    uint8_t sentinel = 0xAB;
    /* Should be a no-op; sentinel must remain unchanged. */
    dewhiten(&sentinel, 0, 37);
    EXPECT_EQ(sentinel, 0xAB);
}

/** @brief AC-6: Single byte round-trip on ch37. */
TEST(Dewhiten, SingleByteRoundTrip) {
    const uint8_t original = 0x55;
    uint8_t nrf24_buf[1];
    uint8_t buf[1];

    simulate_nrf24_tx(&original, 1, 37, nrf24_buf);
    std::memcpy(buf, nrf24_buf, 1);
    dewhiten(buf, 1, 37);
    EXPECT_EQ(buf[0], original);
}

/** @brief AC-7: All-zero input to dewhiten produces the raw whitening sequence bytes.
 *
 * For ch37: whitening masks are {0x8D, 0xD2, 0x57, 0xA1, 0x3D, 0xA7, 0x66, 0xB0}.
 * Input 0x00 → swapbits(0x00) = 0x00 → XOR with mask = mask.
 */
TEST(Dewhiten, AllZeroInput_YieldsWhiteningMasks) {
    /* ch37 masks from ble_whiten_reference.py generate_whitening_sequence(37, 8) */
    const uint8_t expected_ch37[] = {0x8D, 0xD2, 0x57, 0xA1, 0x3D, 0xA7, 0x66, 0xB0};
    /* ch38 masks */
    const uint8_t expected_ch38[] = {0xD6, 0xC5, 0x44, 0x20, 0x59, 0xDE, 0xE1, 0x8F};
    /* ch39 masks */
    const uint8_t expected_ch39[] = {0x1F, 0x37, 0x4A, 0x5F, 0x85, 0xF6, 0x9C, 0x9A};

    struct { uint8_t ch; const uint8_t *expected; } cases[] = {
        {37, expected_ch37},
        {38, expected_ch38},
        {39, expected_ch39},
    };

    for (const auto &tc : cases) {
        uint8_t buf[8] = {0};
        dewhiten(buf, 8, tc.ch);
        for (int i = 0; i < 8; i++) {
            EXPECT_EQ(buf[i], tc.expected[i])
                << "ch=" << (int)tc.ch << " byte " << i
                << ": got 0x" << std::hex << (int)buf[i]
                << " expected 0x" << (int)tc.expected[i];
        }
    }
}

/** @brief AC-6: All-0xFF input to dewhiten produces bitwise complement of whitening masks.
 *
 * For all-0xFF input: swapbits(0xFF) = 0xFF, then XOR with mask = ~mask.
 */
TEST(Dewhiten, AllFFInput) {
    /* ch37: ~masks = {0x72, 0x2D, 0xA8, 0x5E, 0xC2, 0x58, 0x99, 0x4F} */
    const uint8_t expected_ch37[] = {0x72, 0x2D, 0xA8, 0x5E, 0xC2, 0x58, 0x99, 0x4F};
    /* ch38 */
    const uint8_t expected_ch38[] = {0x29, 0x3A, 0xBB, 0xDF, 0xA6, 0x21, 0x1E, 0x70};
    /* ch39 */
    const uint8_t expected_ch39[] = {0xE0, 0xC8, 0xB5, 0xA0, 0x7A, 0x09, 0x63, 0x65};

    struct { uint8_t ch; const uint8_t *expected; } cases[] = {
        {37, expected_ch37},
        {38, expected_ch38},
        {39, expected_ch39},
    };

    for (const auto &tc : cases) {
        uint8_t buf[8];
        std::memset(buf, 0xFF, 8);
        dewhiten(buf, 8, tc.ch);
        for (int i = 0; i < 8; i++) {
            EXPECT_EQ(buf[i], tc.expected[i])
                << "ch=" << (int)tc.ch << " byte " << i
                << ": got 0x" << std::hex << (int)buf[i]
                << " expected 0x" << (int)tc.expected[i];
        }
    }
}

/** @brief AC-6: Maximum-length payload — 32 bytes (nRF24 max payload). */
TEST(Dewhiten, MaxLength32Bytes) {
    /* Simulate a BLE ADV_IND PDU: header=0x40 (ADV_IND, TxAdd=1),
     * length=0x1E (30), plus 30 bytes of AdvData (0x00–0x1D). */
    uint8_t original[32];
    original[0] = 0x40;  /* PDU header: type=0000 (ADV_IND), TxAdd=1 */
    original[1] = 0x1E;  /* PDU length = 30 */
    for (int i = 2; i < 32; i++) original[i] = static_cast<uint8_t>(i - 2);

    uint8_t nrf24_buf[32];
    uint8_t buf[32];

    for (uint8_t ch : {37, 38, 39}) {
        simulate_nrf24_tx(original, 32, ch, nrf24_buf);
        std::memcpy(buf, nrf24_buf, 32);
        dewhiten(buf, 32, ch);
        for (int i = 0; i < 32; i++) {
            EXPECT_EQ(buf[i], original[i])
                << "ch=" << (int)ch << " byte " << i
                << ": got 0x" << std::hex << (int)buf[i]
                << " expected 0x" << (int)original[i];
        }
    }
}

/** @brief AC-5: dewhitening with different channels produces different results.
 *
 * Proves the LFSR seed is channel-dependent. Same input, different channel →
 * different output.
 */
TEST(Dewhiten, CrossChannelIndependence) {
    const uint8_t test_input[] = {0x12, 0x34, 0x56, 0x78};
    uint8_t result_37[4], result_38[4], result_39[4];

    std::memcpy(result_37, test_input, 4);
    std::memcpy(result_38, test_input, 4);
    std::memcpy(result_39, test_input, 4);

    dewhiten(result_37, 4, 37);
    dewhiten(result_38, 4, 38);
    dewhiten(result_39, 4, 39);

    /* All three results must be pairwise different */
    bool same_37_38 = (std::memcmp(result_37, result_38, 4) == 0);
    bool same_37_39 = (std::memcmp(result_37, result_39, 4) == 0);
    bool same_38_39 = (std::memcmp(result_38, result_39, 4) == 0);

    EXPECT_FALSE(same_37_38) << "ch37 and ch38 produced identical dewhiten output";
    EXPECT_FALSE(same_37_39) << "ch37 and ch39 produced identical dewhiten output";
    EXPECT_FALSE(same_38_39) << "ch38 and ch39 produced identical dewhiten output";
}

/** @brief AC-3: Cross-verification with hardcoded known vectors from
 * Dmitry Grinberg's reference implementation.
 *
 * These vectors were computed by ble_whiten_reference.py which implements
 * btLeWhiten exactly as published by Dmitry Grinberg. They are NOT derived
 * from our simulate_nrf24_tx helper — they are fully independent.
 *
 * Test 1: ch37, Grinberg example header (8 bytes)
 * Test 2: ch38, ADV_IND PDU (8 bytes)
 * Test 3: ch39, all-zero (8 bytes) — dewhiten should produce all zeros
 */
TEST(Dewhiten, CrossVerification_Grinberg) {
    /* Vector 1: ch37, Grinberg header
     * Original: {0x40, 0x0B, 0xEF, 0xFF, 0xC0, 0xAA, 0x18, 0x00}
     * nRF24 input (whitened+swapped): {0xB3, 0x9B, 0x1D, 0x7A, 0xBF, 0xB0, 0x7E, 0x0D}
     */
    {
        const uint8_t input[]    = {0xB3, 0x9B, 0x1D, 0x7A, 0xBF, 0xB0, 0x7E, 0x0D};
        const uint8_t expected[] = {0x40, 0x0B, 0xEF, 0xFF, 0xC0, 0xAA, 0x18, 0x00};
        uint8_t buf[8];
        std::memcpy(buf, input, 8);
        dewhiten(buf, 8, 37);
        EXPECT_EQ(std::memcmp(buf, expected, 8), 0)
            << "Grinberg ch37 vector mismatch";
    }

    /* Vector 2: ch38, ADV_IND PDU with AdvA
     * Original: {0x40, 0x06, 0x9B, 0x5A, 0x6A, 0xC0, 0xD4, 0x5F}
     * nRF24 input: {0x69, 0xC3, 0xFB, 0x5E, 0xCC, 0x78, 0xAC, 0x0B}
     */
    {
        const uint8_t input[]    = {0x69, 0xC3, 0xFB, 0x5E, 0xCC, 0x78, 0xAC, 0x0B};
        const uint8_t expected[] = {0x40, 0x06, 0x9B, 0x5A, 0x6A, 0xC0, 0xD4, 0x5F};
        uint8_t buf[8];
        std::memcpy(buf, input, 8);
        dewhiten(buf, 8, 38);
        EXPECT_EQ(std::memcmp(buf, expected, 8), 0)
            << "Grinberg ch38 vector mismatch";
    }

    /* Vector 3: ch39, all-zero original
     * nRF24 input: {0xF8, 0xEC, 0x52, 0xFA, 0xA1, 0x6F, 0x39, 0x59}
     * Expected output: all zeros
     */
    {
        const uint8_t input[] = {0xF8, 0xEC, 0x52, 0xFA, 0xA1, 0x6F, 0x39, 0x59};
        uint8_t buf[8];
        std::memcpy(buf, input, 8);
        dewhiten(buf, 8, 39);
        for (int i = 0; i < 8; i++) {
            EXPECT_EQ(buf[i], 0x00)
                << "ch39 all-zero vector byte " << i
                << ": got 0x" << std::hex << (int)buf[i];
        }
    }

    /* Vector 4: ch37, 32-byte max payload
     * Original: {0x40, 0x1E, 0x00, 0x01, ..., 0x1D}
     * nRF24 input: computed by reference Python
     */
    {
        const uint8_t input[] = {
            0xB3, 0x33, 0xEA, 0x05, 0xFC, 0x25, 0x46, 0xAD,
            0xCE, 0x6C, 0x98, 0x82, 0x39, 0x3E, 0x2F, 0x77,
            0x12, 0x67, 0xDD, 0x83, 0x31, 0x02, 0xE4, 0xB3,
            0x35, 0xF1, 0x08, 0xBC, 0x8B, 0x04, 0x07, 0x36
        };
        uint8_t expected[32];
        expected[0] = 0x40;
        expected[1] = 0x1E;
        for (int i = 2; i < 32; i++) expected[i] = static_cast<uint8_t>(i - 2);

        uint8_t buf[32];
        std::memcpy(buf, input, 32);
        dewhiten(buf, 32, 37);
        EXPECT_EQ(std::memcmp(buf, expected, 32), 0)
            << "Grinberg ch37 32-byte vector mismatch";
    }
}

/** @brief AC-8: Full RX pipeline simulation.
 *
 * Simulates the complete nRF24L01+ → BLE dewhiten pipeline:
 * 1. Start with a known BLE PDU
 * 2. Whiten it (simulating over-the-air BLE whitening)
 * 3. Bit-swap each byte (simulating nRF24 MSbit-first byte order)
 * 4. Call dewhiten() → should recover the original BLE PDU bytes
 */
TEST(Dewhiten, FullRxPipelineSimulation) {
    /* ADV_NONCONN_IND PDU: type=0x02, length=0x06, AdvA + some data */
    const uint8_t ble_pdu[] = {0x42, 0x06, 0x9B, 0x5A, 0x6A, 0xC0, 0xD4, 0x5F};
    uint8_t nrf24_buf[8];
    uint8_t buf[8];

    for (uint8_t ch : {37, 38, 39}) {
        /* Step 1+2: Whiten then swapbits (TX pipeline) */
        simulate_nrf24_tx(ble_pdu, 8, ch, nrf24_buf);
        /* Step 3+4: dewhiten (RX pipeline) */
        std::memcpy(buf, nrf24_buf, 8);
        dewhiten(buf, 8, ch);

        EXPECT_EQ(std::memcmp(buf, ble_pdu, 8), 0)
            << "Full RX pipeline failed for ch=" << (int)ch;
    }
}

/** @brief AC-9: PDU header parsing after dewhitening.
 *
 * After dewhitening a valid BLE advertising PDU, verify:
 * - buf[0] & 0x0F gives a valid PDU type (0–6 for advertising)
 * - buf[1] & 0x3F gives a plausible length (≤ 37 for advertising PDUs)
 */
TEST(Dewhiten, PduHeaderParsingAfterDewhiten) {
    /* ADV_IND: type=0 (bits 3:0=0x00), RxAdd=0, TxAdd=1 → header byte = 0x40,
     * length = 6 → 0x06. This is a valid advertising PDU header. */
    const uint8_t ble_pdu[] = {0x40, 0x06, 0x9B, 0x5A, 0x6A, 0xC0, 0xD4, 0x5F};
    uint8_t nrf24_buf[8];
    uint8_t buf[8];

    simulate_nrf24_tx(ble_pdu, 8, 37, nrf24_buf);
    std::memcpy(buf, nrf24_buf, 8);
    dewhiten(buf, 8, 37);

    uint8_t pdu_type = buf[0] & 0x0F;
    uint8_t pdu_len  = buf[1] & 0x3F;

    EXPECT_LE(pdu_type, 6) << "Invalid PDU type after dewhiten: " << (int)pdu_type;
    EXPECT_LE(pdu_len, 37) << "Invalid PDU length after dewhiten: " << (int)pdu_len;

    /* Verify exact values for this known PDU */
    EXPECT_EQ(pdu_type, 0x00) << "Expected ADV_IND (type 0)";
    EXPECT_EQ(pdu_len, 0x06) << "Expected length 6";
}

/** @brief AC-9: PDU header extraction for ADV_SCAN_IND (type=0x06). */
TEST(Dewhiten, PduHeader_AdvScanInd) {
    /* ADV_SCAN_IND: type=6, TxAdd=1 → header = 0x46, length = 0x0F */
    const uint8_t ble_pdu[] = {0x46, 0x0F, 0x01, 0x02, 0x03, 0x04, 0x05, 0x06};
    uint8_t nrf24_buf[8];
    uint8_t buf[8];

    simulate_nrf24_tx(ble_pdu, 8, 38, nrf24_buf);
    std::memcpy(buf, nrf24_buf, 8);
    dewhiten(buf, 8, 38);

    uint8_t pdu_type = buf[0] & 0x0F;
    uint8_t pdu_len  = buf[1] & 0x3F;

    EXPECT_EQ(pdu_type, 0x06) << "Expected ADV_SCAN_IND (type 6)";
    EXPECT_EQ(pdu_len, 0x0F) << "Expected length 15";
}

/** @brief AC-4: Round-trip with all possible PDU type values (0x00–0x06). */
TEST(Dewhiten, RoundTrip_AllPduTypes) {
    /* Test each valid advertising PDU type (0–6) in the header byte */
    for (int type = 0; type <= 6; type++) {
        uint8_t header = static_cast<uint8_t>(type) | 0x40; /* TxAdd=1 */
        uint8_t original[] = {header, 0x04, 0xAA, 0xBB, 0xCC, 0xDD};
        uint8_t nrf24_buf[6];
        uint8_t buf[6];

        simulate_nrf24_tx(original, 6, 37, nrf24_buf);
        std::memcpy(buf, nrf24_buf, 6);
        dewhiten(buf, 6, 37);

        for (int i = 0; i < 6; i++) {
            EXPECT_EQ(buf[i], original[i])
                << "PDU type " << type << " byte " << i << " mismatch";
        }
    }
}

/** @brief AC-6+AC-4: Round-trip on various payload lengths (1, 2, 6, 16, 31, 32). */
TEST(Dewhiten, RoundTrip_VariousLengths) {
    uint8_t original[32];
    for (int i = 0; i < 32; i++) original[i] = static_cast<uint8_t>(i * 7 + 0x11);

    const uint8_t lengths[] = {1, 2, 6, 16, 31, 32};
    for (uint8_t len : lengths) {
        uint8_t nrf24_buf[32];
        uint8_t buf[32];

        simulate_nrf24_tx(original, len, 37, nrf24_buf);
        std::memcpy(buf, nrf24_buf, len);
        dewhiten(buf, len, 37);

        for (uint8_t i = 0; i < len; i++) {
            EXPECT_EQ(buf[i], original[i])
                << "len=" << (int)len << " byte " << (int)i << " mismatch";
        }
    }
}

/** @brief AC-1 swapbits + AC-4 dewhiten: Verify swapbits(LFSR-only-whitened byte)
 * equals the nRF24-format byte, and dewhiten reverses both steps. */
TEST(Dewhiten, SwapbitsAndWhiteningAreOrthogonal) {
    /* The two steps in dewhiten are independent and reversible:
     * - swapbits is its own inverse (involution)
     * - LFSR XOR whitening is its own inverse (XOR symmetry)
     * Therefore dewhiten(whiten_then_swapbits(x)) == x for any x and any channel.
     * We already proved this via round-trip tests above.
     * This test specifically verifies that the swapbits step and LFSR step
     * don't interfere with each other by checking swapbits(whitened_byte) is
     * distinct from whitened_byte (when the byte is not palindromic). */
    const uint8_t non_palindromic = 0x0F; /* swapbits(0x0F)=0xF0 ≠ 0x0F */
    uint8_t buf[1] = {non_palindromic};

    /* After dewhiten: swapbits(0x0F) → 0xF0, then XOR with mask.
     * If the implementation accidentally skipped swapbits, the result would
     * be different (0x0F ^ mask vs 0xF0 ^ mask). The round-trip test
     * already catches this, but we explicitly verify the intermediate
     * swapbits produces the expected value. */
    EXPECT_NE(swapbits(0x0F), 0x0F) << "swapbits should change 0x0F";
    EXPECT_EQ(swapbits(0x0F), 0xF0) << "swapbits(0x0F) should be 0xF0";
}

/* ═══════════════════════════════════════════════════════════════════════════
 * adv_address() tests
 * ═══════════════════════════════════════════════════════════════════════════ */

/** @brief Helper: build a minimal PDU buffer for a given type.
 *
 * Creates an 8-byte buffer with the PDU type in byte 0, length in
 * byte 1, and AdvA bytes in buf[2..7].  The AdvA is set to a known
 * pattern for extraction testing: {0x01, 0x23, 0x45, 0x67, 0x89, 0xAB}
 * in LSByte-first on-air order, which should extract as
 * {0xAB, 0x89, 0x67, 0x45, 0x23, 0x01} in standard MAC notation.
 *
 * @param type   PDU type value (bits [3:0] of header byte 0).
 * @param buf    Output buffer, must be at least 8 bytes.
 */
static void make_pdu(uint8_t type, uint8_t buf[8])
{
    /* Header byte: type in bits [3:0], TxAdd=0, RxAdd=0 */
    buf[0] = type & 0x0F;
    buf[1] = 0x06; /* PDU length = 6 (AdvA only) */
    /* AdvA in on-air LSByte-first order:
     * buf[2] = LSByte = 0x01, buf[7] = MSByte = 0xAB */
    buf[2] = 0x01; /* LSByte */
    buf[3] = 0x23;
    buf[4] = 0x45;
    buf[5] = 0x67;
    buf[6] = 0x89;
    buf[7] = 0xAB; /* MSByte */
}

/** @brief adv_address correctly extracts AdvA from ADV_IND (type 0).
 *
 * ADV_IND has AdvA in buf[2..7] (LSByte-first on air).
 * Standard MAC notation writes MSByte first, so:
 *   buf[7]:buf[6]:buf[5]:buf[4]:buf[3]:buf[2] → out[0]...out[5].
 */
TEST(AdvAddress, AdvInd) {
    uint8_t buf[8];
    make_pdu(0x00, buf); /* ADV_IND */
    uint8_t out[6] = {0};
    EXPECT_TRUE(adv_address(buf, out));

    /* buf[2]=0x01, buf[3]=0x23, buf[4]=0x45, buf[5]=0x67, buf[6]=0x89, buf[7]=0xAB
     * Standard MAC order: MSByte first → {0xAB, 0x89, 0x67, 0x45, 0x23, 0x01} */
    EXPECT_EQ(out[0], 0xAB);
    EXPECT_EQ(out[1], 0x89);
    EXPECT_EQ(out[2], 0x67);
    EXPECT_EQ(out[3], 0x45);
    EXPECT_EQ(out[4], 0x23);
    EXPECT_EQ(out[5], 0x01);
}

/** @brief adv_address correctly extracts AdvA from ADV_DIRECT_IND (type 1). */
TEST(AdvAddress, AdvDirectInd) {
    uint8_t buf[8];
    make_pdu(0x01, buf); /* ADV_DIRECT_IND */
    uint8_t out[6] = {0};
    EXPECT_TRUE(adv_address(buf, out));
    EXPECT_EQ(out[0], 0xAB);
    EXPECT_EQ(out[5], 0x01);
}

/** @brief adv_address correctly extracts AdvA from ADV_NONCONN_IND (type 2). */
TEST(AdvAddress, AdvNonconnInd) {
    uint8_t buf[8];
    make_pdu(0x02, buf); /* ADV_NONCONN_IND */
    uint8_t out[6] = {0};
    EXPECT_TRUE(adv_address(buf, out));
    EXPECT_EQ(out[0], 0xAB);
    EXPECT_EQ(out[5], 0x01);
}

/** @brief adv_address correctly extracts AdvA from SCAN_RSP (type 4). */
TEST(AdvAddress, ScanRsp) {
    uint8_t buf[8];
    make_pdu(0x04, buf); /* SCAN_RSP */
    uint8_t out[6] = {0};
    EXPECT_TRUE(adv_address(buf, out));
    EXPECT_EQ(out[0], 0xAB);
    EXPECT_EQ(out[5], 0x01);
}

/** @brief adv_address correctly extracts AdvA from ADV_SCAN_IND (type 6). */
TEST(AdvAddress, AdvScanInd) {
    uint8_t buf[8];
    make_pdu(0x06, buf); /* ADV_SCAN_IND */
    uint8_t out[6] = {0};
    EXPECT_TRUE(adv_address(buf, out));
    EXPECT_EQ(out[0], 0xAB);
    EXPECT_EQ(out[5], 0x01);
}

/** @brief adv_address returns false for SCAN_REQ (type 3) — no AdvA. */
TEST(AdvAddress, ScanReq_ReturnsFalse) {
    uint8_t buf[8];
    make_pdu(0x03, buf); /* SCAN_REQ */
    uint8_t out[6] = {0xFF, 0xFF, 0xFF, 0xFF, 0xFF, 0xFF};
    EXPECT_FALSE(adv_address(buf, out));
    /* Output should not be modified on failure */
    EXPECT_EQ(out[0], 0xFF);
    EXPECT_EQ(out[5], 0xFF);
}

/** @brief adv_address returns false for CONNECT_IND (type 5) — no AdvA. */
TEST(AdvAddress, ConnectInd_ReturnsFalse) {
    uint8_t buf[8];
    make_pdu(0x05, buf); /* CONNECT_IND */
    uint8_t out[6] = {0xFF, 0xFF, 0xFF, 0xFF, 0xFF, 0xFF};
    EXPECT_FALSE(adv_address(buf, out));
    EXPECT_EQ(out[0], 0xFF);
    EXPECT_EQ(out[5], 0xFF);
}

/** @brief adv_address returns false for ADV_EXT_IND (type 7) — variable offset. */
TEST(AdvAddress, AdvExtInd_ReturnsFalse) {
    uint8_t buf[8];
    make_pdu(0x07, buf); /* ADV_EXT_IND */
    uint8_t out[6] = {0xFF, 0xFF, 0xFF, 0xFF, 0xFF, 0xFF};
    EXPECT_FALSE(adv_address(buf, out));
    EXPECT_EQ(out[0], 0xFF);
    EXPECT_EQ(out[5], 0xFF);
}

/** @brief adv_address preserves full byte order reversal (end-to-end verification).
 *
 * Use a realistic ADV_IND PDU with a known BLE address:
 *   On-air LSByte-first AdvA: {0xC0, 0xAA, 0x18, 0xEF, 0xFF, 0xCA}
 *   Standard MAC notation:       {0xCA, 0xFF, 0xEF, 0x18, 0xAA, 0xC0}
 *   → expected string: "CA:FF:EF:18:AA:C0"
 */
TEST(AdvAddress, FullByteOrderReversal) {
    uint8_t buf[8] = {
        0x00,  /* PDU type: ADV_IND */
        0x06,  /* PDU length: 6 */
        0xC0,  /* AdvA LSByte */
        0xAA,
        0x18,
        0xEF,
        0xFF,
        0xCA   /* AdvA MSByte */
    };
    uint8_t out[6] = {0};
    EXPECT_TRUE(adv_address(buf, out));

    EXPECT_EQ(out[0], 0xCA);  /* MSByte */
    EXPECT_EQ(out[1], 0xFF);
    EXPECT_EQ(out[2], 0xEF);
    EXPECT_EQ(out[3], 0x18);
    EXPECT_EQ(out[4], 0xAA);
    EXPECT_EQ(out[5], 0xC0);  /* LSByte */
}

/* ═══════════════════════════════════════════════════════════════════════════
 * format_address() tests
 * ═══════════════════════════════════════════════════════════════════════════ */

/** @brief format_address produces standard MAC notation with uppercase hex. */
TEST(FormatAddress, StandardMacNotation) {
    uint8_t addr[6] = {0xCA, 0xFE, 0xBA, 0xBE, 0x00, 0x01};
    const char *result = format_address(addr);
    EXPECT_STREQ(result, "CA:FE:BA:BE:00:01");
}

/** @brief format_address handles all-zero address. */
TEST(FormatAddress, AllZeros) {
    uint8_t addr[6] = {0x00, 0x00, 0x00, 0x00, 0x00, 0x00};
    const char *result = format_address(addr);
    EXPECT_STREQ(result, "00:00:00:00:00:00");
}

/** @brief format_address handles all-FF address. */
TEST(FormatAddress, AllFFs) {
    uint8_t addr[6] = {0xFF, 0xFF, 0xFF, 0xFF, 0xFF, 0xFF};
    const char *result = format_address(addr);
    EXPECT_STREQ(result, "FF:FF:FF:FF:FF:FF");
}

/** @brief format_address uses uppercase hex for digits A-F. */
TEST(FormatAddress, UppercaseHex) {
    uint8_t addr[6] = {0xAB, 0xCD, 0xEF, 0x12, 0x34, 0x56};
    const char *result = format_address(addr);
    EXPECT_STREQ(result, "AB:CD:EF:12:34:56");
}

/** @brief format_address returns a static buffer (not thread-safe, but testable).
 *
 * Two consecutive calls overwrite the same static buffer.
 * Verify the second call's result is correct AND the first result is gone.
 */
TEST(FormatAddress, StaticBufferOverwrite) {
    uint8_t addr1[6] = {0x11, 0x22, 0x33, 0x44, 0x55, 0x66};
    uint8_t addr2[6] = {0xAA, 0xBB, 0xCC, 0xDD, 0xEE, 0xFF};

    const char *result1 = format_address(addr1);
    EXPECT_STREQ(result1, "11:22:33:44:55:66");

    /* Second call overwrites the static buffer */
    const char *result2 = format_address(addr2);
    EXPECT_STREQ(result2, "AA:BB:CC:DD:EE:FF");

    /* result1 now points to the overwritten buffer */
    EXPECT_STREQ(result1, "AA:BB:CC:DD:EE:FF");
}

/* ═══════════════════════════════════════════════════════════════════════════
 * Integrated adv_address + format_address test
 * ═══════════════════════════════════════════════════════════════════════════ */

/** @brief End-to-end: extract AdvA from PDU, then format as string.
 *
 * Simulates the actual usage pattern from main.cpp:
 *   adv_address(buf, addr) → format_address(addr) → printf.
 */
TEST(AdvAddress, IntegrationWithFormatAddress) {
    /* ADV_IND PDU with AdvA = {0xCA, 0xFF, 0xEF, 0x18, 0xAA, 0xC0}
     * in standard MAC notation (MSByte-first). */
    uint8_t buf[8] = {
        0x00,  /* ADV_IND */
        0x06,
        0xC0,  /* LSByte on air */
        0xAA,
        0x18,
        0xEF,
        0xFF,
        0xCA   /* MSByte on air */
    };

    uint8_t addr[6];
    ASSERT_TRUE(adv_address(buf, addr));
    EXPECT_STREQ(format_address(addr), "CA:FF:EF:18:AA:C0");
}

/** @brief End-to-end: PDU type without AdvA prints no address. */
TEST(AdvAddress, IntegrationWithFormatAddress_NoAdvaType) {
    /* SCAN_REQ PDU — no AdvA */
    uint8_t buf[8] = {
        0x03,  /* SCAN_REQ */
        0x06,
        0x01, 0x23, 0x45, 0x67, 0x89, 0xAB
    };

    uint8_t addr[6] = {0xFF, 0xFF, 0xFF, 0xFF, 0xFF, 0xFF};
    EXPECT_FALSE(adv_address(buf, addr));
    /* addr should not have been modified */
    EXPECT_EQ(addr[0], 0xFF);
}